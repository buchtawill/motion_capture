## linux/kv260_ov9281_plnx/project-spec/configs/configs/Kconfig
```kconfig
mainmenu "PetaLinux System Configuration"
config SUBSYSTEM_TYPE_LINUX
        bool
        default y
        select SYSTEM_ZYNQMP

config SYSTEM_ZYNQMP
        bool "ZYNQMP Configuration"
        help
          ZYNQMP Configuration for petalinux project.
          All these config options will be in /home/will/Desktop/motion_capture/linux/kv260_ov9281_plnx/project-spec/configs/config

config SUBSYSTEM_VARIANT_ZYNQMPEV
        bool
        default y
        help

config SUBSYSTEM_DISTRO_PETALINUX
        bool
        default y
        help

source /home/will/Desktop/motion_capture/linux/kv260_ov9281_plnx/project-spec/configs/configs/Kconfig.main
```

## linux/kv260_ov9281_plnx/project-spec/configs/rootfsconfigs/Kconfig.user
```kconfig
menu "user packages " 
config camera-fpga-files  
	 bool "camera-fpga-files"
	 help
	
config gpio-demo  
	 bool "gpio-demo"
	 help
	
config hello  
	 bool "hello"
	 help
	
config mocap-perf  
	 bool "mocap-perf"
	 help
	
config mocap-sanity  
	 bool "mocap-sanity"
	 help
	
config packagegroup-petalinux-kria  
	 bool "packagegroup-petalinux-kria"
	 help
	
config peekpoke  
	 bool "peekpoke"
	 help
	
config rootfs-bashrc  
	 bool "rootfs-bashrc"
	 help
	
endmenu
```
